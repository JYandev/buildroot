## configs/amiibrOS_defconfig
```kconfig
BR2_arm=y
BR2_cortex_a53=y
BR2_ARM_FPU_NEON_VFPV4=y
BR2_PACKAGE_HOST_LINUX_HEADERS_CUSTOM_4_19=y
BR2_TOOLCHAIN_BUILDROOT_WCHAR=y
BR2_TOOLCHAIN_BUILDROOT_CXX=y
BR2_TARGET_GENERIC_HOSTNAME="amiibros"
BR2_TARGET_GENERIC_ISSUE="Welcome to amiibrOS"
BR2_ROOTFS_DEVICE_CREATION_DYNAMIC_EUDEV=y
BR2_TARGET_GENERIC_ROOT_PASSWD="11235813"
BR2_SYSTEM_DHCP="eth0"
BR2_ROOTFS_OVERLAY="../amiibrOS-overlay"
BR2_ROOTFS_POST_BUILD_SCRIPT="board/raspberrypi3/amiibrOS_post-build.sh"
BR2_ROOTFS_POST_IMAGE_SCRIPT="board/raspberrypi3/amiibrOS_post-image.sh"
BR2_LINUX_KERNEL=y
BR2_LINUX_KERNEL_CUSTOM_TARBALL=y
BR2_LINUX_KERNEL_CUSTOM_TARBALL_LOCATION="$(call github,raspberrypi,linux,5eeff139ea9135db6e01a58ef613338f1d0899d8)/linux-5eeff139ea9135db6e01a58ef613338f1d0899d8.tar.gz"
BR2_LINUX_KERNEL_DEFCONFIG="bcm2709"
BR2_LINUX_KERNEL_DTS_SUPPORT=y
BR2_LINUX_KERNEL_INTREE_DTS_NAME="bcm2710-rpi-3-b bcm2710-rpi-3-b-plus bcm2710-rpi-cm3"
BR2_LINUX_KERNEL_NEEDS_HOST_OPENSSL=y
BR2_PACKAGE_BUSYBOX_SHOW_OTHERS=y
BR2_PACKAGE_FLAC=y
BR2_PACKAGE_CHECK=y
BR2_PACKAGE_RPI_BT_FIRMWARE=y
BR2_PACKAGE_RPI_FIRMWARE=y
BR2_PACKAGE_RPI_WIFI_FIRMWARE=y
BR2_PACKAGE_RPI_USERLAND=y
BR2_PACKAGE_PYTHON3=y
BR2_PACKAGE_PYTHON3_SSL=y
BR2_PACKAGE_PYTHON3_PYEXPAT=y
BR2_PACKAGE_PYTHON3_ZLIB=y
BR2_PACKAGE_LIBSNDFILE=y
BR2_PACKAGE_LIBUSB=y
BR2_PACKAGE_AVAHI=y
BR2_PACKAGE_AVAHI_DAEMON=y
BR2_PACKAGE_AVAHI_LIBDNSSD_COMPATIBILITY=y
BR2_PACKAGE_BLUEZ_TOOLS=y
BR2_PACKAGE_BLUEZ5_UTILS=y
BR2_PACKAGE_BLUEZ5_UTILS_OBEX=y
BR2_PACKAGE_BLUEZ5_UTILS_CLIENT=y
BR2_PACKAGE_BLUEZ5_UTILS_DEPRECATED=y
BR2_PACKAGE_BLUEZ5_UTILS_EXPERIMENTAL=y
BR2_PACKAGE_BLUEZ5_UTILS_PLUGINS_HEALTH=y
BR2_PACKAGE_BLUEZ5_UTILS_PLUGINS_MIDI=y
BR2_PACKAGE_BLUEZ5_UTILS_PLUGINS_NFC=y
BR2_PACKAGE_BLUEZ5_UTILS_PLUGINS_SAP=y
BR2_PACKAGE_BLUEZ5_UTILS_PLUGINS_SIXAXIS=y
BR2_PACKAGE_BLUEZ5_UTILS_TEST=y
BR2_PACKAGE_DROPBEAR=y
BR2_PACKAGE_WPA_SUPPLICANT=y
BR2_PACKAGE_PYTHON_ADAFRUIT_CIRCUITPYTHON_PN532=y
BR2_PACKAGE_RETROARCH=y
BR2_PACKAGE_LIBRETRO_SNES9X2010=y
BR2_TARGET_ROOTFS_EXT2=y
BR2_TARGET_ROOTFS_EXT2_4=y
BR2_TARGET_ROOTFS_EXT2_SIZE="4000M"
# BR2_TARGET_ROOTFS_TAR is not set
BR2_PACKAGE_HOST_DOSFSTOOLS=y
BR2_PACKAGE_HOST_GENIMAGE=y
BR2_PACKAGE_HOST_MTOOLS=y
```

## package/python-adafruit-blinka/Config.in
```kconfig
config BR2_PACKAGE_PYTHON_ADAFRUIT_BLINKA
	bool "python-adafruit-blinka"
	select BR2_PACKAGE_PYTHON_ADAFRUIT_PLATFORMDETECT # runtime
	select BR2_PACKAGE_PYTHON_ADAFRUIT_PUREIO # runtime
	select BR2_PACKAGE_PYTHON_RPIGPIO # runtime
	select BR2_PACKAGE_PYTHON_RPI_WS281X # runtime
	select BR2_PACKAGE_PYTHON_SPIDEV # runtime
	select BR2_PACKAGE_PYTHON_SYSV_IPC # runtime
	help
	  CircuitPython APIs for non-CircuitPython versions of Python
	  such as CPython on Linux and MicroPython.

	  https://github.com/adafruit/Adafruit_Blinka
```

## package/python-adafruit-circuitpython-pn532/Config.in
```kconfig
config BR2_PACKAGE_PYTHON_ADAFRUIT_CIRCUITPYTHON_PN532
	bool "python-adafruit-circuitpython-pn532"
	select BR2_PACKAGE_PYTHON_ADAFRUIT_BLINKA # runtime
	select BR2_PACKAGE_PYTHON_ADAFRUIT_CIRCUITPYTHON_BUSDEVICE # runtime
	select BR2_PACKAGE_PYTHON_PYSERIAL # runtime
	help
	  CircuitPython library for controlling PN532 RFID/NFC
	  reader-writer.

	  https://github.com/adafruit/Adafruit_CircuitPython_PN532
```

## package/retroarch/Config.in
```kconfig
config BR2_PACKAGE_RETROARCH
	bool "Retroarch"
	depends on (BR2_PACKAGE_HAS_LIBGLES)
  depends on (BR2_PACKAGE_HAS_LIBEGL)
  depends on (BR2_PACKAGE_HAS_LIBOPENVG)
  depends on (BR2_PACKAGE_ALSA_LIB)
	depends on (BR2_PACKAGE_HAS_UDEV)
  depends on (BR2_PACKAGE_ZLIB)
  depends on (BR2_PACKAGE_FLAC)

	help
	  A multi emulator frontend.

	  http://www.libretro.com

comment "Retroarch depends on EGL or OpenGLES"
	depends on !(BR2_PACKAGE_HAS_LIBEGL || BR2_PACKAGE_HAS_LIBGLES || BR2_PACKAGE_HAS_LIBGL)
```
